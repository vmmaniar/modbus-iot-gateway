## firmware-esp32/main/Kconfig.projbuild
```kconfig
menu "Modbus IoT Gateway"

    config WIFI_SSID
        string "Wi-Fi SSID"
        default "myssid"

    config WIFI_PASSWORD
        string "Wi-Fi password"
        default "mypassword"

    config AWS_IOT_ENDPOINT
        string "AWS IoT Core endpoint"
        default "mqtts://xxxxxxxxxxxxx-ats.iot.us-east-1.amazonaws.com:8883"

    config AWS_IOT_THING_NAME
        string "AWS IoT thing name"
        default "gateway-001"

    config MQTT_TOPIC_TELEMETRY
        string "Telemetry topic"
        default "iot/gateway-001/telemetry"

endmenu
```

## firmware-esp32/sdkconfig.defaults
```kconfig
CONFIG_FREERTOS_HZ=1000
CONFIG_ESP_MAIN_TASK_STACK_SIZE=8192
CONFIG_MBEDTLS_CERTIFICATE_BUNDLE=y
CONFIG_MQTT_PROTOCOL_311=y
CONFIG_MQTT_TRANSPORT_SSL=y
CONFIG_ESP_TLS_USING_MBEDTLS=y
```
